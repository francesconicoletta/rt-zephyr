## CMakeLists.txt
```
cmake_minimum_required(VERSION 3.20.0)

if(BOARD MATCHES "qemu_.*")
  list(APPEND QEMU_EXTRA_FLAGS -serial file:channel0_0)
endif()

find_package(Zephyr REQUIRED HINTS $ENV{ZEPHYR_BASE})
project(rt_zephyr)

target_sources(app PRIVATE src/rt_zephyr.c)
```

## prj.conf
```kconfig
CONFIG_TRACING=y
CONFIG_TRACING_CTF=y
#CONFIG_TRACING_USER=y
CONFIG_TRACING_BUFFER_SIZE=4096
CONFIG_THREAD_NAME=y
CONFIG_MP_NUM_CPUS=1
CONFIG_DEBUG_THREAD_INFO=y
CONFIG_TRACING_BACKEND_UART=y
CONFIG_TRACING_BACKEND_UART_NAME="UART_1"
CONFIG_SCHED_DUMB=y
CONFIG_NEWLIB_LIBC=y # necessary for ldexp
CONFIG_THREAD_RUNTIME_STATS=y
CONFIG_TIMING_FUNCTIONS=y
```

## prj_qemu.conf
```kconfig
CONFIG_TRACING=y
CONFIG_TRACING_CTF=y
CONFIG_TRACING_SYNC=y
CONFIG_THREAD_NAME=y
CONFIG_MP_NUM_CPUS=1
CONFIG_DEBUG_THREAD_INFO=y
CONFIG_TIMING_FUNCTIONS=y
CONFIG_NEWLIB_LIBC=y
CONFIG_TRACING_BACKEND_UART=y
#CONFIG_TRACING_BACKEND_UART_NAME="UART_1"

#CONFIG_SCHED_DUMB=n
#CONFIG_SCHED_SCALABLE=n
#CONFIG_SCHED_MULTIQ=n
CONFIG_SCHED_DEADLINE=y
```

## prj_ram_qemu.conf
```kconfig
CONFIG_NEWLIB_LIBC=y
CONFIG_SCHED_DUMB=y
CONFIG_TIMING_FUNCTIONS=y
CONFIG_TRACING=y
CONFIG_TRACING_CTF=y
CONFIG_THREAD_NAME=y
CONFIG_DEBUG_THREAD_INFO=y
CONFIG_TRACING_BACKEND_RAM=y
CONFIG_RAM_TRACING_BUFFER_SIZE=512

CONFIG_TRACING_THREAD=y
CONFIG_TRACING_CONDVAR=n
CONFIG_TRACING_EVENT=n
CONFIG_TRACING_FIFO=n
CONFIG_TRACING_HEAP=n
CONFIG_TRACING_ISR=n
CONFIG_TRACING_LIFO=n
CONFIG_TRACING_MAILBOX=n
CONFIG_TRACING_MEMORY_SLAB=n
CONFIG_TRACING_MESSAGE_QUEUE=n
CONFIG_TRACING_MUTEX=n
CONFIG_TRACING_PIPE=n
CONFIG_TRACING_QUEUE=n
CONFIG_TRACING_SEMAPHORE=n
CONFIG_TRACING_STACK=n
CONFIG_TRACING_SYSCALL=n
CONFIG_TRACING_TIMER=n
CONFIG_TRACING_WORK=n
#CONFIG_GDBSTUB=y
#CONFIG_MP_NUM_CPUS=1
#CONFIG_THREAD_RUNTIME_STATS=y
#CONFIG_TRACING_USER=y
#CONFIG_TRACING_THREAD_WAIT_THRESHOLD=10000
```

## prj_uart_due.conf
```kconfig
CONFIG_TRACING=y
CONFIG_TRACING_CTF=y
CONFIG_TRACING_SYNC=y
CONFIG_TRACING_PACKET_MAX_SIZE=64
CONFIG_THREAD_NAME=y
CONFIG_TRACING_BACKEND_UART=y
CONFIG_MP_NUM_CPUS=1
CONFIG_DEBUG_THREAD_INFO=y
CONFIG_NEWLIB_LIBC=y
CONFIG_TIMING_FUNCTIONS=y
CONFIG_BOOT_BANNER=n
#CONFIG_PM=n
CONFIG_PRINTK=n

CONFIG_SCHED_DUMB=n
CONFIG_SCHED_SCALABLE=n
CONFIG_SCHED_MULTIQ=y
```

## prj_uart_qemu.conf
```kconfig
CONFIG_NEWLIB_LIBC=y
CONFIG_SCHED_DUMB=y
CONFIG_TIMING_FUNCTIONS=y
CONFIG_TRACING=y
CONFIG_TRACING_CTF=y
CONFIG_THREAD_NAME=y
CONFIG_DEBUG_THREAD_INFO=y
CONFIG_TRACING_SYNC=y
CONFIG_TRACING_BACKEND_UART=y
CONFIG_TRACING_BACKEND_UART_NAME="UART_1"

CONFIG_TRACING_THREAD=y
CONFIG_TRACING_CONDVAR=n
CONFIG_TRACING_EVENT=n
CONFIG_TRACING_FIFO=n
CONFIG_TRACING_HEAP=n
CONFIG_TRACING_ISR=n
CONFIG_TRACING_LIFO=n
CONFIG_TRACING_MAILBOX=n
CONFIG_TRACING_MEMORY_SLAB=n
CONFIG_TRACING_MESSAGE_QUEUE=n
CONFIG_TRACING_MUTEX=n
CONFIG_TRACING_PIPE=n
CONFIG_TRACING_QUEUE=n
CONFIG_TRACING_SEMAPHORE=n
CONFIG_TRACING_STACK=n
CONFIG_TRACING_SYSCALL=n
CONFIG_TRACING_TIMER=n
CONFIG_TRACING_WORK=n
```

## prj_uart_vega.conf
```kconfig
#CONFIG_TRACING=y
#CONFIG_TRACING_CTF=y
#CONFIG_TRACING_SYNC=y
#CONFIG_THREAD_NAME=y
#CONFIG_MP_NUM_CPUS=1
#CONFIG_TRACING_BACKEND_UART=y
#CONFIG_DEBUG_THREAD_INFO=y
#CONFIG_TIMING_FUNCTIONS=y
#CONFIG_NEWLIB_LIBC=y
#CONFIG_BOOT_BANNER=n
#CONFIG_PM=n
##CONFIG_CONSOLE=n
#CONFIG_PRINTK=n

CONFIG_TRACING=y
CONFIG_TRACING_CTF=y
CONFIG_TRACING_SYNC=y
CONFIG_TRACING_PACKET_MAX_SIZE=64
CONFIG_THREAD_NAME=y
CONFIG_TRACING_BACKEND_UART=y
CONFIG_MP_NUM_CPUS=1
CONFIG_DEBUG_THREAD_INFO=y
CONFIG_NEWLIB_LIBC=y
CONFIG_TIMING_FUNCTIONS=y
CONFIG_BOOT_BANNER=n
#CONFIG_PM=n
CONFIG_PRINTK=n
```

## prj_uart_vega_print.conf
```kconfig
CONFIG_DEBUG_THREAD_INFO=y
CONFIG_NEWLIB_LIBC=y
CONFIG_TIMING_FUNCTIONS=y
CONFIG_UART_CONSOLE=y
CONFIG_PRINTK=y
```

## src/main.c
```c
#include <logging/log.h>
#include <sys/printk.h>
#include <usb/usb_device.h>
#include <zephyr.h>
#include "rt_zephyr.h"

#define STACKSIZE 1024

#define INIT_PRIORITY -1

K_THREAD_STACK_DEFINE(init_thread_stack_area, STACKSIZE);
static struct k_thread init_thread_data;

void init_thread(void *dummy1, void *dummy2, void *dummy3)
{
	ARG_UNUSED(dummy1);
	ARG_UNUSED(dummy2);
	ARG_UNUSED(dummy3);

	uint32_t p_load = 0;

	printk("init_thread started \n");
	p_load = calibrate_cpu_cycles();
	printk("p_load: %d \n", p_load);

	printk("init_thread abort\n");
	k_thread_abort(&init_thread_data);
}

void main(void)
{
	k_tid_t init_id;
	k_thread_runtime_stats_t rt_stats_thread;

	init_id = k_thread_create(&init_thread_data, init_thread_stack_area,
			K_THREAD_STACK_SIZEOF(init_thread_stack_area),
			init_thread, NULL, NULL, NULL,
			INIT_PRIORITY, 0, K_FOREVER);
	k_thread_name_set(&init_thread_data, "init_thread");

	k_thread_start(&init_thread_data);

	k_thread_runtime_stats_get(init_id, &rt_stats_thread);

	/*
	 * with CONFIG_SCHED_THREAD_USAGE_ANALYSIS we can use current_cycles,
	 * peak_cycles, average_cycles
	 */
	printk("Cycles: %llu\n", rt_stats_thread.execution_cycles);
}
```

## src/rt_zephyr.c
```c
#include <math.h>
#include <stdlib.h>
#include <string.h>
#include <stdio.h>
#include <zephyr/timing/timing.h>
#include <zephyr/sys_clock.h>
#include <zephyr/sys/printk.h>
#include <zephyr/kernel.h>
#include "rt_zephyr.h"
#include "rt_zephyr_types.h"

static int p_load = 0;

k_timeout_t delay(int del)
{
	switch(del) {
	case -1:
		return K_FOREVER;
	case 0:
		return K_NO_WAIT;
	default:
		return K_USEC(del);
	}
}

void waste_cpu_cycles(int load_loops)
{
	double param;
	double n;
	double result;
	unsigned long long i;

	param = 0.95;
	n = 4;
	for (i = 0; i < load_loops * 4; i++) {
		result = ldexp(param, (ldexp(param, ldexp(param, n))));
		result = ldexp(param, (ldexp(param, ldexp(param, n))));
		result = ldexp(param, (ldexp(param, ldexp(param, n))));
		result = ldexp(param, (ldexp(param, ldexp(param, n))));
	}
}

int calibrate_cpu_cycles(void)
{
	int max_load_loop = 10000, cal_trial = 1000;
	timing_t start_time, end_time;
	uint64_t diff, nsec_per_loop, avg_per_loop = 0;

	timing_init();
	timing_start();

	while (cal_trial) {
		cal_trial--;

		start_time = timing_counter_get();
		waste_cpu_cycles(max_load_loop);
		end_time = timing_counter_get();

		diff = timing_cycles_to_ns(timing_cycles_get(&start_time,
					&end_time));
		nsec_per_loop = diff / max_load_loop;
		avg_per_loop = (avg_per_loop + nsec_per_loop) >> 1;

		if ((abs(nsec_per_loop - avg_per_loop) * 50) < avg_per_loop)
			return avg_per_loop;

		max_load_loop += 3333;
		max_load_loop %= 1000000;
	}

	timing_stop();
	return 0;
}

static inline unsigned long loadwait(unsigned long exec)
{
	unsigned long load_count, secs, perf;
	int i;

	/*
	 * Performace is the fixed amount of work that is performed by this run
	 * phase. We need to compute it here because both load_count and exec
	 * might be modified below.
	 */
	perf = exec / p_load;

	/*
	 * If exec is still too big, let's run it in bursts
	 * so that we don't overflow load_count.
	 */
	secs = exec / 1000000;

	for (i = 0; i < secs; i++) {
		load_count = 1000000000/p_load;
		waste_cpu_cycles(load_count);
		exec -= 1000000;
	}

	/* Run for the remainig exec (if any). */
	load_count = (exec * 1000) / p_load;
	waste_cpu_cycles(load_count);
	return perf;
}

uint32_t run_event(event_data_t *event, unsigned long *perf, log_data_t *ldata)
{
	/* TODO: log data */
	uint32_t start_time = 0, stop_time = 0;
	switch(event->type) {
	case ev_run:
		{
			start_time = k_cycle_get_32();
			*perf += loadwait(event->duration);
			stop_time = k_cycle_get_32();
		}
		break;
	case ev_sleep:
		{
			start_time = k_cycle_get_32();
			k_sleep(K_USEC(event->duration));
			stop_time = k_cycle_get_32();
		}
		break;
	}
	return k_cyc_to_ms_floor32(stop_time - start_time);
}

void run_thread(void *thread_data, void *dummy2, void *dummy3)
{
	ARG_UNUSED(dummy2);
	ARG_UNUSED(dummy3);

	unsigned long perf = 0;
	uint32_t duration;
	log_data_t ldata = {0};
	thread_data_t *tdata = (thread_data_t *) thread_data;
	event_data_t *events = tdata->events;

	for (int j = 0; j < tdata->loop; j++) {
		for (int i = 0; i < tdata->nbevents; i++) {
			duration = run_event(&events[i], &perf, &ldata);
			printk("event[%d] - %s - duration %lu\n",
					i, events[i].name,
					(unsigned long) duration);
		}
	}
}

uint32_t cycles_per_sec()
{
	uint32_t start_time, stop_time;
	start_time = k_cycle_get_32();
	loadwait(1000000);
	stop_time = k_cycle_get_32();
	printk("%d cycles for 1 sec\n", stop_time - start_time);
	return stop_time - start_time;
}

NEWTHREADSTACK(th1)
NEWTHREADSTACK(th1lo1)
NEWTHREADSTACK(th1lo2)

NEWTHREADSTACK(th2)
NEWTHREADSTACK(th2lo1)

void main(void)
{
	/* nanoseconds per loop */
	p_load = calibrate_cpu_cycles();
	printk("p_load: %d \n", p_load);

#ifdef CONFIG_SCHED_DEADLINE
	uint32_t csec = cycles_per_sec();
#endif

	DEFTHREAD(th1, 2, 0, 4, 1)
	NEWEVENT(th1, "th1 ev0 run", 0, ev_run, 2000000)
	NEWEVENT(th1, "th1 ev1 sleep", 1, ev_sleep, 2000000)

	DEFTHREAD(th2, 2, 0, 6, 1)
	NEWEVENT(th2, "th2 ev0 run", 0, ev_run, 3000000)
	NEWEVENT(th2, "th2 ev1 sleep", 1, ev_sleep, 3000000)

	DEFTHREAD(th1lo1, 2, 4000000, 4, 1)
	NEWEVENT(th1lo1, "th1lo1 ev0 run", 0, ev_run, 2000000)
	NEWEVENT(th1lo1, "th1lo1 ev1 sleep", 1, ev_sleep, 2000000)

	DEFTHREAD(th2lo1, 2, 6000000, 6, 1)
	NEWEVENT(th2lo1, "th2lo1 ev0 run", 0, ev_run, 3000000)
	NEWEVENT(th2lo1, "th2lo1 ev1 sleep", 1, ev_sleep, 3000000)

	DEFTHREAD(th1lo2, 2, 8000000, 4, 1)
	NEWEVENT(th1lo2, "th1lo2 ev0 run", 0, ev_run, 2000000)
	NEWEVENT(th1lo2, "th1lo2 ev1 sleep", 1, ev_sleep, 2000000)
}
```

## src/rt_zephyr.h
```c
#pragma once

#define XSTR(s) STR(s)
#define STR(s) #s

#define STACKSIZE	1024
#define MAX_EVENTS	5

#define NEWTHREADSTACK(t_name)							\
	K_THREAD_STACK_DEFINE(thread_stack_##t_name, STACKSIZE);		\
	struct k_thread thread_data_##t_name;

#define CRTHREAD(t_name)							\
	thread_tid_##t_name = k_thread_create(&thread_data_##t_name,		\
			thread_stack_##t_name,					\
			K_THREAD_STACK_SIZEOF(thread_stack_##t_name),		\
			run_thread, &thread_##t_name, NULL, NULL,		\
			thread_##t_name.priority, 0, thread_##t_name.delay);	\
	k_thread_name_set(&thread_data_##t_name, thread_##t_name.name);

#define THREADVARS(t_name, evn, del, lo, pri)					\
	static k_tid_t thread_tid_##t_name;					\
	static thread_data_t thread_##t_name;					\
	static event_data_t events_##t_name[MAX_EVENTS];			\
	thread_##t_name.events = events_##t_name;				\
	thread_##t_name.nbevents = evn;						\
	thread_##t_name.delay = delay(del);					\
	thread_##t_name.loop = lo;						\
	thread_##t_name.priority = pri;						\
	thread_##t_name.name = XSTR(t_name);					\

#ifndef CONFIG_SCHED_DEADLINE
#define DEFTHREAD(t_name, evn, del, lo, pri)					\
	THREADVARS(t_name, evn, del, lo, pri)					\
	CRTHREAD(t_name)
#else
#define DEFTHREAD(t_name, evn, del, lo, pri)					\
	THREADVARS(t_name, evn, del, 1, pri)					\
	CRTHREAD(t_name)							\
	k_thread_deadline_set(thread_tid_##t_name, csec * lo +			\
			del / 1000000 * csec);					\
	printk("deadline %d\n", k_cyc_to_ms_floor32(csec * lo +			\
			del / 1000000 * csec));
#endif

#define STARTTHREAD(t_name)	k_thread_start(&thread_data_##t_name);

#define NEWEVENT(t_name, ev_name, num, ev_type, usecs)				\
	events_##t_name[num].name = XSTR(ev_name);				\
	events_##t_name[num].type = ev_type;					\
	events_##t_name[num].duration = usecs;
```

## src/rt_zephyr_types.h
```c
#pragma once

typedef enum resource_t
{
	ev_run,
	ev_sleep
} resource_t;

typedef struct _event_data_t {
	char *name;
	unsigned long duration;
	resource_t type;
} event_data_t;

typedef struct _thread_data_t {
	char *name;
	event_data_t *events;
	int loop;
	int nbevents;
	int priority;
	k_timeout_t delay;
} thread_data_t;
```

## src/tracing_user.c
```c
#include <tracing_user.h>

void sys_trace_thread_switched_in_user(struct k_thread *thread)
{
	printk("%s: %p\n", __func__, thread);
}

void sys_trace_thread_switched_out_user(struct k_thread *thread)
{
	printk("%s: %p\n", __func__, thread);
}
```
